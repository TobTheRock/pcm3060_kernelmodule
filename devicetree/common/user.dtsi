/ {
    
	compatible = "hardkernel,odroid-n2", "amlogic,s922x", "amlogic,g12b";
    pcm3060 {
        compatible = "ext_pcm3060";
        pwms = <&pwm_cd 0 1250 0>;
        pwm-names = "pwm_pcm3060_sck";
        gpio_lrck_pcm3060 = <&gpio GPIOA_4 GPIO_ACTIVE_HIGH>;
        gpio_bck_pcm3060 = <&gpio GPIOX_11 GPIO_ACTIVE_HIGH>;
        gpio_din_pcm3060 = <&gpio GPIOX_8 GPIO_ACTIVE_HIGH>;
        gpio_dout_pcm3060 = <&gpio GPIOX_9 GPIO_ACTIVE_HIGH>;
    };
};
